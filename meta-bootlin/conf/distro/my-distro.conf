## meta-bootlin/conf/distro/my-distro.conf
```bitbake
require conf/distro/poky.conf

DISTRO = "my-distro"
DISTRO_NAME = "My Custom Distro"
DISTRO_VERSION = "1.0"
MAINTAINER = "Issam Sayyaf <issamsayyaf97@gmail.com>"

DISTRO_FEATURES:append = " systemd"
DISTRO_FEATURES:remove = " x11 wayland"
PACKAGE_CLASSES ?= "package_rpm"
EXTRA_IMAGE_FEATURES ?= "debug-tweaks"
USER_CLASSES ?= "buildstats image-mklibs image-prelink"
VIRTUAL-RUNTIME_init_manager = "systemd"
VIRTUAL-RUNTIME_initscripts = ""
INIT_MANAGER ?= "systemd"
SDKIMAGE_FEATURES = "dev-pkgs dbg-pkgs"
PREFERRED_PROVIDER_virtual/nativesdk-llvm = "clang"
PREFERRED_PROVIDER_virtual/libgl = "mesa-gl"
DISTRO_DEFAULT_LOCALE = "en_US.UTF-8"
TIMEZONE = "UTC"
```

## meta-bootlin/conf/layer.conf
```bitbake
# We have a conf and classes directory, add to BBPATH
BBPATH .= ":${LAYERDIR}"

# We have recipes-* directories, add to BBFILES
BBFILES += "${LAYERDIR}/recipes-*/*/*.bb \
            ${LAYERDIR}/recipes-*/*/*.bbappend"

BBFILE_COLLECTIONS += "meta-bootlin"
BBFILE_PATTERN_meta-bootlin = "^${LAYERDIR}/"
BBFILE_PRIORITY_meta-bootlin = "7"

LAYERDEPENDS_meta-bootlin = "core"
LAYERSERIES_COMPAT_meta-bootlin = "kirkstone"
```

## meta-bootlin/conf/machine/bootlinlabs-beagleplay-k3r5.conf
```bitbake
require conf/machine/include/k3r5.inc

PREFERRED_PROVIDER_virtual/bootloader = "u-boot-bb.org"
PREFERRED_PROVIDER_u-boot = "u-boot-bb.org"

SYSFW_SOC = "am62x"
SYSFW_CONFIG = "evm"
SYSFW_SUFFIX = "gp"
SYSFW_PREFIX:bootlinlabs-k3r5 = "fs"

UBOOT_MACHINE = "am62x_evm_r5_defconfig"

MACHINEOVERRIDES =. "beagleplay-k3r5:"
```

## meta-bootlin/conf/machine/bootlinlabs-beagleplay.conf
```bitbake
require conf/machine/include/k3.inc
require conf/machine/include/extlinux-bb.inc

SOC_FAMILY:append = ":am62xx"

SERIAL_CONSOLES = "115200;ttyS2"
SERIAL_CONSOLES_CHECK = "${SERIAL_CONSOLES}"

TFA_BOARD = "lite"
TFA_K3_SYSTEM_SUSPEND = "1"

OPTEEMACHINE = "k3-am62x"

UBOOT_MACHINE = "am62x_evm_a53_defconfig"

PREFERRED_PROVIDER_virtual/kernel = "linux-bb.org"
PREFERRED_PROVIDER_virtual/bootloader = "u-boot-bb.org"
PREFERRED_PROVIDER_u-boot = "u-boot-bb.org"

KERNEL_DEVICETREE = " \
ti/k3-am625-beagleplay.dtb \
"

MACHINE_ESSENTIAL_EXTRA_RDEPENDS += "kernel-devicetree kernel-image-image"

MACHINEOVERRIDES =. "beagle:"
```

## meta-bootlin/conf/machine/bootlinlabs-stm32.conf
```bitbake
require conf/machine/include/st-machine-common-stm32mp.inc
require conf/machine/include/st-machine-providers-stm32mp.inc

DEFAULTTUNE = "cortexa7thf-neon-vfpv4"
require conf/machine/include/arm/armv7a/tune-cortexa7.inc

UBOOT_CONFIG = "trusted_stm32mp15"
STM32MP_DT_FILES_DK = "stm32mp157f-dk2"

MACHINE_FEATURES += "m4copro"
```

## meta-bootlin/conf/machine/bootlinlabs.conf
```bitbake
require conf/machine/include/ti-soc.inc
SOC_FAMILY:append = ":ti33x"

DEFAULTTUNE = "armv7athf-neon"
require conf/machine/include/arm/armv7a/tune-cortexa8.inc

PREFERRED_PROVIDER_virtual/kernel ?= "linux-ti-staging"
PREFERRED_PROVIDER_virtual/bootloader ?= "u-boot-ti-staging"

KERNEL_IMAGETYPE = "zImage"
KERNEL_DEVICETREE = "am335x-boneblack.dtb am335x-boneblack-wireless.dtb"

UBOOT_ARCH = "arm"
UBOOT_MACHINE = "am335x_evm_config"

UBOOT_ENTRYPOINT = "0x80008000"
UBOOT_LOADADDRESS = "0x80008000"

SERIAL_CONSOLES = "115200;ttyS0"

MACHINE_FEATURES = "apm usbgadget usbhost vfat ext2 ethernet"

EXTRA_IMAGEDEPENDS:append = " virtual/bootloader"
```
